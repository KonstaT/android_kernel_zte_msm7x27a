## drivers/i2c/chips/Kconfig
```kconfig
#
# Miscellaneous I2C chip drivers configuration
#
# *** DEPRECATED! Do not add new entries! See Makefile ***
#

menu "Miscellaneous I2C Chip support"

config SENSORS_TSL2771
	tristate "Taos TSL2771 ambient light and prox sensor"
	depends on I2C
	default n
	help
	  If you say yes here you get support for the Taos TSL2771
	  ambient light and prox sensor.

config SENSORS_MT9T013
	tristate "MT9T013 Camera Driver"
	depends on I2C
	default y
	help
	  MT9T013 Camera Driver implemented by HTC.

endmenu
```
